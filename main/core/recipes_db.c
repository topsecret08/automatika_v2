#include "recipes_db.h"
#include "sd_content.h"
#include "ui/ui.h"
#include "esp_log.h"

#include <stdio.h>
#include <string.h>

static const char *TAG = "RECIPES";

const recipe_t RECIPES[] = {
    {
        .id = "sp.whisky",
        .name = "Шотландский Single Malt",
        .category = "spirit",
        .description = "Торфяной солод, двойная перегонка",
        .ingredients = "Торфяной ячменный солод 5 кг, дрожжи 20 г, вода 25 л",
        .steps_md =
            "1. Затирание 65 °C, 90 мин.\n"
            "2. Промывка 76 °C, собрать 25 л сусла.\n"
            "3. Брожение 18…20 °C, 4–5 дней.\n"
            "4. Первая перегонка — до 0 % в струе.\n"
            "5. Вторая — с отбором голов 5–10 % и тела до 65 % об.\n"
            "6. Выдержка в дубовой бочке от 3 лет.",
    },
    {
        .id = "sp.bourbon",
        .name = "Бурбон",
        .category = "spirit",
        .description = "Кукуруза 70 %, рожь 20 %, ячмень 10 %",
        .ingredients = "Кукуруза 3,5 кг, рожь 1 кг, солод 0,5 кг, дрожжи 20 г",
        .steps_md =
            "1. Кукурузу заварить при 90 °C, осахарить солодом при 63 °C.\n"
            "2. Брожение 25…30 °C, 3–4 дня.\n"
            "3. Перегонка в ПВК, отбор тела до 60 % об.\n"
            "4. Выдержка в новой обожжённой бочке 2–4 года.",
    },
    {
        .id = "sp.cognac",
        .name = "Коньяк",
        .category = "spirit",
        .description = "Белый кислый виноград, двойная перегонка",
        .ingredients = "Виноград (Уни Блан) 50 кг, дрожжи 100 г",
        .steps_md =
            "1. Отжать сок, брожение 20 °C до 10 % об.\n"
            "2. Перегонка в аламбике до 30 % об.\n"
            "3. Вторая перегонка с отбором голов и тела до 60 % об.\n"
            "4. Выдержка в дубе 2 года и более.",
    },
    {
        .id = "sp.calvados",
        .name = "Кальвадос",
        .category = "spirit",
        .description = "Яблочный сидр, мягкая перегонка",
        .ingredients = "Яблоки 60 кг (смесь кислых и сладких), дрожжи 100 г",
        .steps_md =
            "1. Сидр крепостью 6–8 % об., брожение 3 недели.\n"
            "2. Перегонка до 30 % об.\n"
            "3. Вторая перегонка: тело 65–70 % об.\n"
            "4. Выдержка в дубе от 2 лет.",
    },
    {
        .id = "sp.dark_rum",
        .name = "Dark Rum",
        .category = "spirit",
        .description = "Меласса, карамель, выдержка",
        .ingredients = "Меласса 5 кг, сахар 1 кг, дрожжи 30 г, вода 25 л",
        .steps_md =
            "1. Развести мелассу, брожение 30 °C, 5 дней.\n"
            "2. Перегонка в кубе с дефлегматором.\n"
            "3. Отбор тела до 60 % об.\n"
            "4. Выдержка в дубе, карамель для цвета.",
    },
    {
        .id = "sp.gin_london",
        .name = "London Dry Gin",
        .category = "spirit",
        .description = "Можжевельник и десять ботаникалов",
        .ingredients = "Спирт 96 % — 5 л, можжевельник 100 г, кориандр 40 г, "
                       "корень ириса 10 г, цедра лимона 20 г, цедра апельсина 20 г, "
                       "анис 5 г, фенхель 5 г, кардамон 5 г, дягиль 5 г, перец 2 г",
        .steps_md =
            "1. Настоять ботаникалы на спирте 12–24 ч.\n"
            "2. Перегнать на колонне, отбирая тело 60–75 % об.\n"
            "3. Разбавить до 43–47 % об.\n"
            "4. Отдых 2–3 дня перед розливом.",
    },
    {
        .id = "mash.sugar.classic",
        .name = "Сахарная классическая",
        .category = "mash",
        .description = "5 кг сахара на 20 л, простой старт",
        .ingredients = "Сахар 5 кг, вода 20 л, дрожжи 100 г",
        .steps_md =
            "1. Растворить сахар в тёплой воде (30…35 °C).\n"
            "2. Внести дрожжи, гидрозатвор.\n"
            "3. Брожение 25…28 °C, 5–7 дней.\n"
            "4. Готовность: гидрозатвор молчит 24 ч, горечь во вкусе.\n"
            "5. Осветлить и перегнать при 78…92 °C в теле.",
    },
    {
        .id = "mash.sugar.invert",
        .name = "Инвертированный сахар",
        .category = "mash",
        .description = "Сахар с лимонной кислотой — мягче вкус",
        .ingredients = "Сахар 5 кг, вода 20 л, лимонная кислота 10 г, дрожжи 100 г",
        .steps_md =
            "1. Сироп 80 °C + лимонная кислота, варить 30 мин.\n"
            "2. Остудить до 30 °C, внести дрожжи.\n"
            "3. Брожение 25…28 °C, 4–6 дней.\n"
            "4. Перегонка стандартная.",
    },
    {
        .id = "mash.grain.barley",
        .name = "Ячменная брага",
        .category = "mash",
        .description = "Ячмень 5 кг, ферменты, дрожжи",
        .ingredients = "Ячмень 5 кг, Амилосубтилин 10 г, Глюкаваморин 10 г, "
                       "дрожжи 20 г, вода 25 л",
        .steps_md =
            "1. Разварить крупу при 90…95 °C, 60 мин.\n"
            "2. Остудить до 60 °C, внести ферменты, осахарить 60 мин.\n"
            "3. Остудить до 30 °C, внести дрожжи.\n"
            "4. Брожение 6–8 дней.\n"
            "5. Перегонка в ПВК — брага густая.",
    },
    {
        .id = "mash.fruit.apple",
        .name = "Яблочная брага",
        .category = "mash",
        .description = "Яблоки 20 кг под кальвадос",
        .ingredients = "Яблоки 20 кг, дрожжи 50 г, сахар 1 кг (по кислоте)",
        .steps_md =
            "1. Измельчить яблоки, добавить пектолитический фермент.\n"
            "2. Внести дрожжи, брожение 20 °C, 2–3 недели.\n"
            "3. Снять с осадка, отжать.\n"
            "4. Перегонка до 30 % об., затем дробная.",
    },
};

const size_t RECIPES_COUNT = sizeof(RECIPES) / sizeof(RECIPES[0]);

void recipes_init(void) {
    ESP_LOGI(TAG, "Встроенных рецептов: %u", (unsigned)RECIPES_COUNT);

    if (!sd_content_ready()) return;

    char names[32][SD_CONTENT_MAX_NAME];
    int n = sd_content_list(CT_RECIPES, names, 32);
    ESP_LOGI(TAG, "Файлов рецептов на SD: %d", n);
}

const recipe_t* recipes_find(const char *id) {
    if (!id) return NULL;
    for (size_t i = 0; i < RECIPES_COUNT; i++) {
        if (strcmp(RECIPES[i].id, id) == 0) return &RECIPES[i];
    }
    return NULL;
}

void recipes_show(const recipe_t *r) {
    if (!r) return;

    static char md[1536];
    snprintf(md, sizeof(md),
             "# %s\n\n"
             "_%s_\n\n"
             "## Ингредиенты\n%s\n\n"
             "## Порядок работы\n%s\n",
             r->name,
             r->description ? r->description : "",
             r->ingredients ? r->ingredients : "—",
             r->steps_md ? r->steps_md : "—");

    ui_show_markdown(r->name, md);
}
