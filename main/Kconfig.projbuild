## main/Kconfig.projbuild
```kconfig
menu "Verification / shadow mode"

    config VERIFY_ENABLE
        bool "Enable shadow mode, staged flags and SQLite verification"
        default y
        help
            Включает verify_config, shadow, verify_db, safety_gate и
            REST /api/verify/*. Для релизной сборки можно выключить:
            сложные алгоритмы не смогут применяться, останется только
            критическая логика.

    config ADAPTIVE_PID_ENABLE
        bool "Enable multi-layer adaptive PID"
        default y
        help
            L1 gain scheduling, L2 RLS/IMC, L3 degradation rollback.
            При выключении ctrl_pid использует обычный PID/AutoPID.

endmenu
```
